## prj.conf
```kconfig
# base
CONFIG_TFM_PROFILE_TYPE_MINIMAL=y
CONFIG_STACK_SENTINEL=y

CONFIG_REBOOT=y
CONFIG_PICOLIBC_IO_FLOAT=y
CONFIG_STACK_SENTINEL=y
CONFIG_RING_BUFFER=y
CONFIG_FPU=y

# Stacks and heaps
CONFIG_MAIN_STACK_SIZE=4096
CONFIG_HEAP_MEM_POOL_SIZE=4096
CONFIG_SYSTEM_WORKQUEUE_STACK_SIZE=4096

# Log
CONFIG_LOG=y
CONFIG_LOG_DEFAULT_LEVEL=3
CONFIG_LOG_BUFFER_SIZE=2048
CONFIG_LOG_BACKEND_RTT=n
CONFIG_LOG_BACKEND_UART=y
CONFIG_LOG_BACKEND_UART_BUFFER_SIZE=2048

# Modem library
CONFIG_NRF_MODEM_LIB=y
CONFIG_NRF_MODEM_LIB_TRACE=n
CONFIG_ZVFS_OPEN_MAX=8

# FLASH # NVS
CONFIG_FLASH=y
CONFIG_FLASH_MAP=y
CONFIG_FLASH_PAGE_LAYOUT=y
CONFIG_MPU_ALLOW_FLASH_WRITE=y
CONFIG_NVS=y

# GNSS
CONFIG_GNSS=y
CONFIG_GNSS_SATELLITES=y
CONFIG_GNSS_DUMP_TO_LOG=y

# LTE link control
CONFIG_LTE_LINK_CONTROL=y
```

## src/main.c
```c
#include <zephyr/kernel.h>
#include <zephyr/logging/log.h>
#include <nrf_modem.h> 
#include <nrf_modem_at.h> 
#include <nrf_modem_gnss.h>
#include <modem/nrf_modem_lib.h>
#include <modem/lte_lc.h>

LOG_MODULE_REGISTER(main, CONFIG_LOG_DEFAULT_LEVEL);

static struct nrf_modem_gnss_pvt_data_frame gnss_data;

static void gnss_event_handler(int event)
{
    int retval;

	switch (event) {
	case NRF_MODEM_GNSS_EVT_PVT:
		LOG_INF("NRF_MODEM_GNSS_EVT_PVT");
        retval = nrf_modem_gnss_read(&gnss_data, sizeof(gnss_data), NRF_MODEM_GNSS_DATA_PVT);
		if (retval) {
			LOG_ERR("nrf_modem_gnss_read failed, err %d", retval);
		}
        if (gnss_data.flags & NRF_MODEM_GNSS_PVT_FLAG_FIX_VALID) {
			LOG_INF("latitude:   %f", gnss_data.latitude);
        	LOG_INF("longitude:  %f", gnss_data.longitude);
		} else {}
		break;
	case NRF_MODEM_GNSS_EVT_FIX:
		LOG_DBG("NRF_MODEM_GNSS_EVT_FIX");
		break;
	case NRF_MODEM_GNSS_EVT_NMEA:
		LOG_INF("NRF_MODEM_GNSS_EVT_NMEA");
        break;
	case NRF_MODEM_GNSS_EVT_AGNSS_REQ:
		LOG_INF("NRF_MODEM_GNSS_EVT_AGNSS_REQ");
		break;
	case NRF_MODEM_GNSS_EVT_BLOCKED:
		LOG_DBG("NRF_MODEM_GNSS_EVT_BLOCKED");
		break;
	case NRF_MODEM_GNSS_EVT_UNBLOCKED:
		LOG_DBG("NRF_MODEM_GNSS_EVT_UNBLOCKED");
		break;
	case NRF_MODEM_GNSS_EVT_PERIODIC_WAKEUP:
		LOG_DBG("NRF_MODEM_GNSS_EVT_PERIODIC_WAKEUP");
		break;
	case NRF_MODEM_GNSS_EVT_SLEEP_AFTER_TIMEOUT:
		LOG_DBG("NRF_MODEM_GNSS_EVT_SLEEP_AFTER_TIMEOUT");
		break;
	case NRF_MODEM_GNSS_EVT_SLEEP_AFTER_FIX:
		LOG_DBG("NRF_MODEM_GNSS_EVT_SLEEP_AFTER_FIX");
		break;
	default:
		LOG_WRN("Unknown GNSS event %d", event);
		break;
	}
}

int main(void)
{
    int err;
    err = nrf_modem_lib_init();
    if(err < 0)
        LOG_ERR("Unable to initialize modem lib. (err: %i)", err);

    LOG_INF("=====GNSS EXAMPLE=====");
	
	err = lte_lc_system_mode_set(LTE_LC_SYSTEM_MODE_LTEM_GPS, LTE_LC_SYSTEM_MODE_PREFER_LTEM);
	if(err < 0) {
		LOG_ERR("Falied to set lte system mode %d", err);
		return 0;
	}

	err = nrf_modem_at_printf("AT%%XCOEX0=1,1,1565,1586");
	if(err != 0) {
		LOG_ERR("Falied to set modem %d", err);
		return 0;
	}

    err = lte_lc_func_mode_set(LTE_LC_FUNC_MODE_ACTIVATE_GNSS);
	if(err < 0) {
		LOG_ERR("Falied to set lte func mode %d", err);
		return 0;
	}

    err = nrf_modem_gnss_event_handler_set(gnss_event_handler);
	if (err != 0) {
		LOG_ERR("Failed to set GNSS event handler %d", err);
		return 0;
	}

	uint16_t nmea_mask = NRF_MODEM_GNSS_NMEA_GGA_MASK;
	err = nrf_modem_gnss_nmea_mask_set(nmea_mask);
	if (err < 0) {
		LOG_ERR("Failed to set GNSS NMEA mask %d", err);
		return 0;
	}

	/* This use case flag should always be set. */
	uint8_t use_case = NRF_MODEM_GNSS_USE_CASE_MULTIPLE_HOT_START;
	err = nrf_modem_gnss_use_case_set(use_case);
	if (err < 0) {
		LOG_WRN("Failed to set GNSS use case %d", err);
	}

	err = nrf_modem_gnss_fix_retry_set(0);
	if (err < 0) {
		LOG_ERR("Failed to set GNSS fix retry %d", err);
		return 0;
	}

	err = nrf_modem_gnss_fix_interval_set(1);
	if (err < 0) {
		LOG_ERR("Failed to set GNSS fix interval %d", err);
		return 0;
	}

	LOG_INF("GNSS initialized");

	err = nrf_modem_gnss_start();
	if (err < 0) {
		LOG_ERR("Failed to start GNSS, err: %d", err);
		return 0;
	}

    return 0;
}
```
