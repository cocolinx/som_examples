## CMakeLists.txt
```
cmake_minimum_required(VERSION 3.20.0)

find_package(Zephyr REQUIRED HINTS $ENV{ZEPHYR_BASE})

project(adc)

target_sources(app PRIVATE src/main.c)
```

## prj.conf
```kconfig
# base
CONFIG_TFM_PROFILE_TYPE_MINIMAL=y
CONFIG_STACK_SENTINEL=y

CONFIG_REBOOT=y
CONFIG_PICOLIBC_IO_FLOAT=y
CONFIG_STACK_SENTINEL=y
CONFIG_RING_BUFFER=y
CONFIG_FPU=y

# Stacks and heaps
CONFIG_MAIN_STACK_SIZE=4096
CONFIG_HEAP_MEM_POOL_SIZE=4096
CONFIG_SYSTEM_WORKQUEUE_STACK_SIZE=4096

# Log
CONFIG_LOG=y
CONFIG_LOG_DEFAULT_LEVEL=3
CONFIG_LOG_BUFFER_SIZE=2048
CONFIG_LOG_BACKEND_RTT=n
CONFIG_LOG_BACKEND_UART=y
CONFIG_LOG_BACKEND_UART_BUFFER_SIZE=2048

# Modem library
CONFIG_NRF_MODEM_LIB=y
CONFIG_NRF_MODEM_LIB_TRACE=n
CONFIG_ZVFS_OPEN_MAX=8

# FLASH # NVS
CONFIG_FLASH=y
CONFIG_FLASH_MAP=y
CONFIG_FLASH_PAGE_LAYOUT=y
CONFIG_MPU_ALLOW_FLASH_WRITE=y
CONFIG_NVS=y

# ADC
CONFIG_ADC=y
CONFIG_ADC_NRFX_SAADC=y
```

## src/main.c
```c
#include <zephyr/kernel.h>
#include <zephyr/logging/log.h>
#include <nrf_modem.h> 
#include <nrf_modem_at.h> 
#include <modem/nrf_modem_lib.h>
#include <zephyr/drivers/adc.h>
#include <zephyr/dt-bindings/adc/nrf-saadc.h>
#include <hal/nrf_saadc.h>

LOG_MODULE_REGISTER(main, CONFIG_LOG_DEFAULT_LEVEL);

static const struct device *adc_dev = DEVICE_DT_GET(DT_NODELABEL(adc));
static struct adc_channel_cfg channel_cfg;
static struct adc_sequence adc_sequence;

static uint16_t adc_buffer;

int main(void)
{
    int err;
    err = nrf_modem_lib_init();
    if(err < 0) {
        LOG_ERR("Unable to initialize modem lib. (err: %d)", err);
        return 0;
    }

    LOG_INF("=====ADC EXAMPLE=====");

    int mv;

    /* adc init */
    channel_cfg.channel_id = 1;
    channel_cfg.gain = ADC_GAIN_1_5; /* 3.0v */
    channel_cfg.reference = ADC_REF_INTERNAL;
    channel_cfg.acquisition_time = ADC_ACQ_TIME(ADC_ACQ_TIME_MICROSECONDS, 40);
    channel_cfg.differential = false;
    channel_cfg.input_positive = NRF_SAADC_AIN2; 
    channel_cfg.input_negative = NRF_SAADC_INPUT_DISABLED;

    adc_sequence.options = NULL;
    adc_sequence.channels = BIT(1);
    adc_sequence.buffer = &adc_buffer;
    adc_sequence.buffer_size = 2;
    adc_sequence.resolution = 14;
    adc_sequence.oversampling = 4;
    adc_sequence.calibrate = true;

    err = adc_channel_setup(adc_dev, &channel_cfg);
    if(err < 0) {
        LOG_ERR("Falied to set adc channel %d", err);
        return 0;
    }

    while(true) {
        err = adc_read(adc_dev, &adc_sequence);
        if(err < 0) {
            LOG_INF("Failed to read adc: %d", err);
            if(err == -EBUSY) continue;
            else break;
        }
        mv = adc_buffer;
        mv = (mv * 3000) / 16383; /* mv: 0~3000 */
        LOG_INF("adc value: %d", mv);
        k_msleep(1000);
    }
    return 0;
}
```
