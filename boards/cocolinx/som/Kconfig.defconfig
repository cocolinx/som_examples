## boards/cocolinx/som/Kconfig.defconfig
```kconfig
# CocoLinx SOM configuration

# Copyright (c) 2025 cocolinx
# Copyright (c) 2018-2020 Nordic Semiconductor ASA
# SPDX-License-Identifier: Apache-2.0

config HW_STACK_PROTECTION
	default ARCH_HAS_STACK_PROTECTION

if BOARD_COCOLINX_SOM_NRF9151 || BOARD_COCOLINX_SOM_NRF9151_NS

config BOARD_COCOLINX_SOM
	select USE_DT_CODE_PARTITION if BOARD_COCOLINX_SOM_NRF9151_NS	

endif # BOARD_COCOLINX_SOM
```
